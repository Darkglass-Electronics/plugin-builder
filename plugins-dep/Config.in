## plugins-dep/Config.in
```kconfig
config BR2_EXTERNAL
    string
    option env="BR2_EXTERNAL"

source "$BR2_EXTERNAL/package/carla-backend/Config.in"
source "$BR2_EXTERNAL/package/darkglass-lv2-extensions/Config.in"
source "$BR2_EXTERNAL/package/darkglass-plugin-builder/Config.in"
source "$BR2_EXTERNAL/package/hylia/Config.in"
source "$BR2_EXTERNAL/package/jack2mod/Config.in"
source "$BR2_EXTERNAL/package/kxstudio-lv2-extensions/Config.in"
source "$BR2_EXTERNAL/package/libnickel/Config.in"
source "$BR2_EXTERNAL/package/zix/Config.in"
```
